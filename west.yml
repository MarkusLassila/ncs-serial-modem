## west.yml
```yaml
# Copyright (c) 2025 Nordic Semiconductor
# SPDX-License-Identifier: LicenseRef-Nordic-5-Clause

manifest:
  self:
    import: submanifests

  remotes:
    - name: ncs
      url-base: https://github.com/nrfconnect

  projects:
    - name: nrf
      remote: ncs
      repo-path: sdk-nrf
      revision: 2962f07044012f05e69932275769b7aaac5991a6
      import:
        name-allowlist:
          - cjson
          - cmsis_6
          - cmock
          - hal_nordic
          - libmodem
          - mbedtls
          - mcuboot
          - memfault-firmware-sdk
          - nrfxlib
          - oberon-psa-crypto
          - segger
          - trusted-firmware-m
          - zcbor
          - zephyr
```
