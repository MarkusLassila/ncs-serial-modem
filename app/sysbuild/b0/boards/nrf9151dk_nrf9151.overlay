/*
 * Copyright (c) 2026 Nordic Semiconductor ASA
 *
 * SPDX-License-Identifier: LicenseRef-Nordic-5-Clause
 */

#include "../../../boards/nrf9151dk_nrf9151_partition.dtsi"
#include "../../../boards/nrf9151dk_nrf9151_sram_bootloader.dtsi"

/ {
	chosen {
		zephyr,code-partition = &b0_partition;
		zephyr,console = &uart1;
	};
};

&uart1 {
	current-speed = <1000000>;
	status = "okay";
};
